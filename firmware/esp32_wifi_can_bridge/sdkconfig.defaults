## firmware/esp32_wifi_can_bridge/sdkconfig.defaults
```kconfig
CONFIG_FREERTOS_HZ=1000
CONFIG_ESPTOOLPY_FLASHSIZE_16MB=y
CONFIG_AUTOSTART_ARDUINO=y
CONFIG_ARDUINO_VARIANT="esp32s3"
CONFIG_TINYUSB_NET_MODE_NCM=y
# CONFIG_TINYUSB_CDC_ENABLED is not set
CONFIG_TINYUSB_TASK_AFFINITY_CPU0=y
```
